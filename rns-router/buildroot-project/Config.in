## rns-router/buildroot-project/package/extlinux-target/Config.in
```kconfig
config BR2_PACKAGE_EXTLINUX_TARGET
	bool "extlinux-target"
	depends on BR2_x86_64
	help
	  Syslinux 'extlinux' bootloader installer, built with the target
	  toolchain so it can run inside the OPX live system at install time.

	  Buildroot's own boot/syslinux package builds this tool for the build
	  host; the OPX installer (rns-install.sh) runs it on the target to set
	  up an installed (on-disk) boot: 'extlinux -i <bootdir>' writes the
	  patched boot sector, ldlinux.sys and ldlinux.c32 for an ext4 /boot.
```

## rns-router/buildroot-project/package/rns/Config.in
```kconfig
config BR2_PACKAGE_RNS
	bool "rns"
	help
	  RNS Gateway router OS scripts, portal, and admin panel.
```
